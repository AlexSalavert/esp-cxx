## components/bmx280/example/main/Kconfig.projbuild
```kconfig
menu "EXAMPLE BMX280 CONFIGURATION"

    config EXAMPLE_I2C_PORT
        int "i2c port"
        default -1
        help
            port for i2c

    config EXAMPLE_I2C_SDA_GPIO
        int "i2c sda gpio"
        default 2
        help
            gpio number for sda i2c

    config EXAMPLE_I2C_SCL_GPIO
        int "i2c scl gpio"
        default 1
        help
            gpio number for sda i2c

    choice EXAMPLE_BMX280_ADDRESS
        prompt "I2C Slave Address"
        default BMX280_ADDRESS_LOW
        help
            Set the slave address of the sensor.
        
        config EXAMPLE_BMX280_ADDRESS_LOW
            bool "0x76 (SDO LOW)"
            help
                SDO LOW.

        config EXAMPLE_BMX280_ADDRESS_HIGH
            bool "0x77 (SDO HIGH)"
            help 
                SDO HIGH.
    endchoice

    choice EXAMPLE_BMX280_MODEL
        prompt "bmx280 model"
        default EXAMPLE_BME280
        help
            Bmx280 model of sensor select.

        config EXAMPLE_BME280
            bool "bme280"
            help
                model bme280 whith humidity measuring.

        config EXAMPLE_BMP280
            bool "bmp280"
            help
                model bmp280 whithout humidity measuring.
    endchoice

    choice EXAMPLE_BMX280_CONFIG
        prompt "bmx280 config"
        default EXAMPLE_INDOOR_NAVIGATION
        help
            Choose one of the default configurations of the bmx280 driver.

        config EXAMPLE_WEATHER_MONNITORING
            bool "weather monitoring"

        config EXAMPLE_HUMIDITY_SENSING
            bool "humidity sensing"
            depends on EXAMPLE_BME280
        
        config EXAMPLE_INDOOR_NAVIGATION
            bool "indoor navigation"
        
        config EXAMPLE_GAMING
            bool "gaming"

        config EXAMPLE_HIGH_PRECISSION
            bool "high precision"

    endchoice
        
            
endmenu
```

## components/dwin_hmi/example/main/Kconfig.projbuild
```kconfig
menu "EXAMPLE DWIN HMI CONFIGURATION"

    config EXAMPLE_UART_NUM
        int "uart num"
        default 1
        help
            Port for uart

    config EXAMPLE_UART_TX_GPIO
        int "uart tx gpio"
        default 10
        help
            GPIO number for tx uart.
    
    config EXAMPLE_UART_RX_GPIO
        int "uart rx gpio"
        default 11
        help
            GPIO number for rx uart.

    config EXAMPLE_UART_BAUDRATE
        int "uart baudrate"
        default 115200
        help 
            Baudrate for uart.

    config EXAMPLE_ACTIVATE_EVENTS_TEST
        bool "activate events test"
        default y
        help
            Activate events if dwin is configured to send events (touch functions)

    config EXAMPLE_ACTIVATE_PAGE_TEST
        bool "activate page test"
        default y
        help
            activate set and get page test

    config EXAMPLE_TEST_PAGE_ADDR
        int "test page addr"
        default 0
        depends on EXAMPLE_ACTIVATE_PAGE_TEST
        help
            16-bit address for the page configured in dwin by the user.

    config EXAMPLE_ACTIVATE_VP_TEST
        bool "activate vp test"
        default y
        help
            Activate set and get vp test

    config EXAMPLE_TEST_VP_ADDR
        int "test vp addr"
        default 0
        depends on EXAMPLE_ACTIVATE_VP_TEST
        help
            16-bit address for the vp variable configured in dwin by the user.

    config EXAMPLE_TEST_VP_VALUE
        int "test vp value"
        default 0
        depends on EXAMPLE_ACTIVATE_VP_TEST
        help
            16-bit value for the vp variable configured in dwin by the user.

    config EXAMPLE_ACTIVATE_TEXT_TEST
        bool "activate text test"
        default y
        help
            activate set text test

    config EXAMPLE_TEST_TEXT_ADDR
        int "test text addr"
        default 0
        depends on EXAMPLE_ACTIVATE_TEXT_TEST
        help
            16-bit address for text configured in dwin by the user.

    config EXAMPLE_TEST_TEXT_VALUE
        string "test text value"
        default "hello"
        depends on EXAMPLE_ACTIVATE_TEXT_TEST
        help
            text value for the text variable configured in dwin by the user.

    config EXAMPLE_ACTIVATE_BACKLIGTH_TEST
        bool "activate backligth test"
        default y
        help
            activate set and get backligth test

    config EXAMPLE_TEST_BACKLIGTH_VALUE
        int "test backligth value"
        range 0 100
        default 100
        depends on EXAMPLE_ACTIVATE_BACKLIGTH_TEST
        help
            0 to 100 value for backligth
        
            
endmenu
```

## components/i2c/example/main/Kconfig.projbuild
```kconfig
menu "EXAMPLE I2C CONFIGURATION"

    config EXAMPLE_I2C_PORT
        int "i2c port"
        default 0
        help
            port for i2c

    config EXAMPLE_I2C_SDA_GPIO
        int "i2c sda gpio"
        default 10
        help
            gpio number for sda i2c

    config EXAMPLE_I2C_SCL_GPIO
        int "i2c scl gpio"
        default 11
        help
            gpio number for sda i2c

    config EXAMPLE_I2C_ADDRESS
        int "i2c address"
        default 0
        help
            Address for i2c protocol.

    config EXAMPLE_I2C_TIMEOUT_MS
        int "i2c timeout ms"
        default -1
        help
            Timeout in ms for i2c protocol, set -1 for unlimited time.

    choice EXAMPLE_I2C_MODE
        prompt "i2c mode "
        default EXAMPLE_MASTER
        help
            I2c master device or i2c slave select.

        config EXAMPLE_I2C_MASTER
            bool "i2c master"
            help
                I2c master.

        config EXAMPLE_I2C_SLAVE
            bool "i2c slave"
            help
                I2c slave.
    endchoice

    config EXAMPLE_ACTIVATE_I2C_DEVICE_WRITE_TEST
        bool "activate i2c device write test"
        default y
        depends on EXAMPLE_I2C_MASTER
        help
            Activate test write for i2c device.

    config EXAMPLE_ACTIVATE_I2C_DEVICE_READ_TEST
        bool "activate i2c device read test"
        default y
        depends on EXAMPLE_I2C_MASTER
        help
            Activate test read for i2c device.

    config EXAMPLE_I2C_MASTER_REGISTER_WRITE
        int "i2c master register write"
        default 0 
        depends on EXAMPLE_ACTIVATE_I2C_DEVICE_WRITE_TEST
        help
            Register byte i2c used for write master example.

    config EXAMPLE_I2C_MASTER_DATA_WRITE
        int "i2c master data write"
        default 0 
        depends on EXAMPLE_ACTIVATE_I2C_DEVICE_WRITE_TEST
        help
            Data byte i2c used for write master example.

    config EXAMPLE_I2C_MASTER_REGISTER_READ
        int "i2c master register read"
        default 0
        depends on EXAMPLE_ACTIVATE_I2C_DEVICE_READ_TEST
        help
            Register byte i2c used for read master example.

    config EXAMPLE_I2C_SLAVE_DATA
        int "i2c slave data"
        default 0
        depends on EXAMPLE_I2C_SLAVE
        help
            Data byte the slave will send when the master requests a read.

endmenu
```

## components/status_led/example/main/Kconfig.projbuild
```kconfig
menu "EXAMPLE STATUS LED CONFIGURATION"

    config EXAMPLE_LED_GPIO
        int "led_gpio"
        default 10
        help
            GPIO number for led

    choice EXAMPLE_LED_TYPE
        prompt "led_type"
        default EXAMPLE_LED_TYPE_WS2812
        help
            Select the LED type for the example.

        config EXAMPLE_LED_TYPE_SIMPLE
            bool "SimpleLed"
            help
                Simple led.

        config EXAMPLE_LED_TYPE_WS2812
            bool "Ws2812Led"
            help
                RGB LED controlled by ws2812 module.
    endchoice

    config EXAMPLE_ACTIVE_HIGH
        bool "active_high"
        default true
        depends on EXAMPLE_LED_TYPE_SIMPLE
        help
            logic for activating the simple LED.

    config EXAMPLE_NUMBER_OF_LEDS
        int "number_of_leds"
        range 1 100
        default 1
        depends on EXAMPLE_LED_TYPE_WS2812
        help
            Number of WS2812 LEDs.

    config EXAMPLE_BRIGHTNESS
        range 0 255
        int "brightness"
        default 50
        depends on EXAMPLE_LED_TYPE_WS2812
        help
            brightness for WS2812 LEDs.

endmenu
```
